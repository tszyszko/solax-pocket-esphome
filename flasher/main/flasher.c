// SolaX Pocket WiFi (ESP32-S2) in-app factory flasher, ESP-IDF 4.4.4.
//
// Delivered through SolaX's own MQTT OTA into whichever stock OTA slot is free.
// On boot it joins Wi-Fi (RAM only, no NVS), then:
//   1. POSTs the whole 4 MB flash to REPORT/dump/<offset> in 16 x 256 KB pieces
//      (the stock backup), halting if any piece fails;
//   2. streams REPORT/factory.bin and checks its length and MD5 against the
//      values compiled in from factory_expect.h (generated by build.sh);
//   3. POSTs "ready" and polls GET REPORT/go until the body is "GO";
//   4. downloads factory.bin 0x0..0x10000 into RAM and checks its MD5
//      (EXP_HEAD_MD5), halting before any write if that fails;
//   5. writes factory.bin 0x0..len exactly like esptool would, but in a safe
//      order: app region first (streamed over HTTP), then from the RAM copy, no
//      network: partition table, otadata/phy, bootloader LAST; every 4 KB sector
//      is read back and compared. Range responses must be 206 with the exact
//      Content-Length, or the flasher halts;
//   6. MD5s the written flash and reboots only on a match.
// Slot logic: running from SolaX ota_1 (0x110000) -> the app goes to ESPHome
// app0 (0x10000) and otadata is left erased; running from SolaX ota_0
// (0x10000) -> the app goes to ESPHome app1 (0x1D0000), so we never overwrite
// ourselves, and a crafted otadata (seq=2) selects app1.
// STATUS: built, NOT YET EXERCISED ON HARDWARE. See README.md.
#include <string.h>
#include <stdlib.h>
#include "freertos/FreeRTOS.h"
#include "freertos/task.h"
#include "freertos/event_groups.h"
#include "esp_system.h"
#include "esp_log.h"
#include "esp_wifi.h"
#include "esp_netif.h"
#include "esp_event.h"
#include "esp_http_client.h"
#include "esp_flash.h"
#include "esp_spi_flash.h"
#include "mbedtls/md5.h"
#include "esp_rom_crc.h"
#include "secrets.h"          /* WSSID, WPASS, REPORT - generated by build.sh */
#include "factory_expect.h"   /* EXP_LEN, EXP_MD5 of factory.bin - generated by build.sh */
#if !defined(WSSID) || !defined(WPASS) || !defined(REPORT)
#error "secrets.h must define WSSID, WPASS and REPORT (run build.sh)"
#endif
#if !defined(EXP_LEN) || !defined(EXP_MD5) || !defined(EXP_HEAD_MD5)
#error "factory_expect.h must define EXP_LEN, EXP_MD5 and EXP_HEAD_MD5 (run build.sh)"
#endif
#define SEC 4096
#define HEAD 0x10000          /* factory.bin 0x0..0x10000: bootloader, ptable, otadata/phy */
static uint8_t*head;          /* malloc'd first thing in app_main (a static 64 KB overflows dram0_0_seg);
                                 filled after GO, before any write */
static const char*TAG="fl";
static EventGroupHandle_t eg;
static char msg[512];
static void on_evt(void*a,esp_event_base_t b,int32_t id,void*d){
  if(b==WIFI_EVENT&&id==WIFI_EVENT_STA_START) esp_wifi_connect();
  else if(b==WIFI_EVENT&&id==WIFI_EVENT_STA_DISCONNECTED) esp_wifi_connect();
  else if(b==IP_EVENT&&id==IP_EVENT_STA_GOT_IP) xEventGroupSetBits(eg,1);
}
static void post(const char*path,const char*s){
  char url[96]; snprintf(url,sizeof url,REPORT "/%s",path);
  esp_http_client_config_t c={.url=url,.method=HTTP_METHOD_POST,.timeout_ms=10000};
  esp_http_client_handle_t h=esp_http_client_init(&c); int n=strlen(s);
  if(esp_http_client_open(h,n)==ESP_OK){esp_http_client_write(h,s,n);esp_http_client_fetch_headers(h);}
  esp_http_client_cleanup(h); ESP_LOGI(TAG,"%s: %s",path,s);
}
// stream a flash region to the receiver as POST /dump/<hex offset>
static int post_flash(uint32_t off,uint32_t len){
  char url[96]; snprintf(url,sizeof url,REPORT "/dump/%08x",(unsigned)off);
  esp_http_client_config_t c={.url=url,.method=HTTP_METHOD_POST,.timeout_ms=30000};
  esp_http_client_handle_t h=esp_http_client_init(&c); int ok=0;
  if(esp_http_client_open(h,len)==ESP_OK){ static uint8_t b[SEC]; uint32_t sent=0;
    for(uint32_t a=0;a<len;a+=SEC){ esp_flash_read(NULL,b,off+a,SEC); if(esp_http_client_write(h,(char*)b,SEC)!=SEC)break; sent+=SEC; }
    esp_http_client_fetch_headers(h); ok=(sent==len)&&(esp_http_client_get_status_code(h)==200); }
  esp_http_client_cleanup(h); return ok?0:-1;
}
static void hex(const unsigned char*d,char*o){for(int i=0;i<16;i++)sprintf(o+2*i,"%02x",d[i]);o[32]=0;}
// open GET /factory.bin for [start,end] inclusive; returns handle or NULL
static esp_http_client_handle_t open_range(uint32_t start,uint32_t end){
  esp_http_client_config_t c={.url=REPORT "/factory.bin",.timeout_ms=15000};
  esp_http_client_handle_t h=esp_http_client_init(&c); char r[48]; snprintf(r,sizeof r,"bytes=%u-%u",(unsigned)start,(unsigned)end);
  esp_http_client_set_header(h,"Range",r);
  if(esp_http_client_open(h,0)!=ESP_OK){esp_http_client_cleanup(h);return NULL;}
  esp_http_client_fetch_headers(h); return h;
}
// a Range response must be 206 with exactly the requested length; a server that
// ignores Range answers 200 with the file from offset 0, which must never be written
static int range_bad(esp_http_client_handle_t h,uint32_t start,uint32_t len){
  int st=esp_http_client_get_status_code(h); long long cl=(long long)esp_http_client_get_content_length(h);
  if(st==206&&cl==(long long)len) return 0;
  snprintf(msg,sizeof msg,"RANGE_BAD at file 0x%x: status %d content-length %lld, want 206 / %u",(unsigned)start,st,cl,(unsigned)len); return -1;
}
static int read_full(esp_http_client_handle_t h,uint8_t*buf,int want){ int got=0; while(got<want){int r=esp_http_client_read(h,(char*)buf+got,want-got); if(r<=0)break; got+=r;} return got; }
static int go_ready(void){
  esp_http_client_config_t c={.url=REPORT "/go",.timeout_ms=8000}; esp_http_client_handle_t h=esp_http_client_init(&c); char b[8]={0}; int ok=0;
  if(esp_http_client_open(h,0)==ESP_OK){esp_http_client_fetch_headers(h); int n=esp_http_client_read(h,b,sizeof b-1); ok=(n>=2&&b[0]=='G'&&b[1]=='O');}
  esp_http_client_cleanup(h); return ok;
}
static int md5_http(char*out){ // pass 1: stream whole file, md5
  esp_http_client_handle_t h=open_range(0,EXP_LEN-1); if(!h)return -1;
  static uint8_t buf[SEC]; mbedtls_md5_context m; mbedtls_md5_init(&m); mbedtls_md5_starts_ret(&m); int total=0;
  for(;;){int r=esp_http_client_read(h,(char*)buf,SEC); if(r<=0)break; mbedtls_md5_update_ret(&m,buf,r); total+=r;}
  unsigned char d[16]; mbedtls_md5_finish_ret(&m,d); mbedtls_md5_free(&m); esp_http_client_cleanup(h); hex(d,out); return total;
}
// erase one 4 KB sector at a, write n bytes of src, read back and compare
static int write_sector(uint32_t a,const uint8_t*src,int n){
  static uint8_t rb[SEC];
  esp_err_t e1=esp_flash_erase_region(NULL,a,SEC); esp_err_t e2=esp_flash_write(NULL,src,a,n);
  esp_flash_read(NULL,rb,a,n);
  if(e1||e2||memcmp(src,rb,n)){snprintf(msg,sizeof msg,"WRITE_FAIL at %x erase=%d write=%d cmp=%d",(unsigned)a,e1,e2,memcmp(src,rb,n));return -1;}
  vTaskDelay(1); return 0;
}
// write [start,end) of the file, streamed over HTTP, to flash at dst, sector by sector
static int write_range(uint32_t start,uint32_t end,uint32_t dst){
  esp_http_client_handle_t h=open_range(start,end-1); if(!h){snprintf(msg,sizeof msg,"OPEN_FAIL %x",(unsigned)start);return -1;}
  if(range_bad(h,start,end-start)){esp_http_client_cleanup(h);return -1;}
  static uint8_t buf[SEC]; uint32_t a=dst;
  while(a<dst+(end-start)){ uint32_t left=dst+(end-start)-a;
    int want=(left<SEC)?(int)left:SEC; int got=read_full(h,buf,want);
    if(got!=want){snprintf(msg,sizeof msg,"SHORT_READ at %x got %d want %d",(unsigned)a,got,want);esp_http_client_cleanup(h);return -1;}
    if(write_sector(a,buf,got)){esp_http_client_cleanup(h);return -1;}
    a+=got;
  }
  esp_http_client_cleanup(h); return 0;
}
// write [start,end) of the file from the RAM copy (start,end <= HEAD) to the same addresses; no network
static int write_head(uint32_t start,uint32_t end){
  for(uint32_t a=start;a<end;a+=SEC) if(write_sector(a,head+a,SEC)) return -1;
  return 0;
}
// after GO, before any write: factory.bin 0x0..0x10000 into RAM, length + MD5 checked
static int fetch_head(void){
  esp_http_client_handle_t h=open_range(0,HEAD-1); if(!h){snprintf(msg,sizeof msg,"HEAD_OPEN_FAIL - nothing written");return -1;}
  if(range_bad(h,0,HEAD)){esp_http_client_cleanup(h);strlcat(msg," - nothing written",sizeof msg);return -1;}
  int got=read_full(h,head,HEAD); esp_http_client_cleanup(h);
  if(got!=HEAD){snprintf(msg,sizeof msg,"HEAD_SHORT got %d want %d - nothing written",got,HEAD);return -1;}
  unsigned char d[16]; char m5[33]; mbedtls_md5_context m; mbedtls_md5_init(&m); mbedtls_md5_starts_ret(&m);
  mbedtls_md5_update_ret(&m,head,HEAD); mbedtls_md5_finish_ret(&m,d); mbedtls_md5_free(&m); hex(d,m5);
  if(strcmp(m5,EXP_HEAD_MD5)){snprintf(msg,sizeof msg,"HEAD_MD5_BAD %s want %s - nothing written",m5,EXP_HEAD_MD5);return -1;}
  return 0;
}
static int write_otadata_app1(void){
  static uint8_t sec0[32]; memset(sec0,0xFF,32); uint32_t seq=2; memcpy(sec0,&seq,4);
  uint32_t crc=esp_rom_crc32_le(UINT32_MAX,(uint8_t*)&seq,4); memcpy(sec0+28,&crc,4);
  esp_err_t e1=esp_flash_erase_region(NULL,0x9000,0x2000); esp_err_t e2=esp_flash_write(NULL,sec0,0x9000,32);
  uint8_t rb[32]; esp_flash_read(NULL,rb,0x9000,32);
  if(e1||e2||memcmp(sec0,rb,32)){snprintf(msg,sizeof msg,"OTADATA_FAIL %d %d",e1,e2);return -1;} return 0;
}
static uint32_t APP_DST=0x10000;
static void md5_flash(char*out){ static uint8_t buf[SEC]; mbedtls_md5_context m; mbedtls_md5_init(&m); mbedtls_md5_starts_ret(&m);
  for(uint32_t a=0;a<EXP_LEN;a+=SEC){int n=(EXP_LEN-a<SEC)?(int)(EXP_LEN-a):SEC;
    if(a>=0x9000&&a<0x10000) memset(buf,0xFF,n);            /* logically FF in factory.bin */
    else if(a>=0x10000) esp_flash_read(NULL,buf,APP_DST+(a-0x10000),n);
    else esp_flash_read(NULL,buf,a,n);
    mbedtls_md5_update_ret(&m,buf,n);}
  unsigned char d[16]; mbedtls_md5_finish_ret(&m,d); mbedtls_md5_free(&m); hex(d,out); }
static void halt(const char*why){ post("HALT",why); for(;;){vTaskDelay(pdMS_TO_TICKS(30000)); post("HALT",why);} }
void app_main(void){
  uint32_t phys=spi_flash_cache2phys((const void*)app_main);
  head=malloc(HEAD);            /* before Wi-Fi, while the heap is unfragmented */
  eg=xEventGroupCreate(); esp_netif_init(); esp_event_loop_create_default();
  esp_netif_t*nif=esp_netif_create_default_wifi_sta(); esp_netif_set_hostname(nif,"solax-flasher");
  wifi_init_config_t wc=WIFI_INIT_CONFIG_DEFAULT(); wc.nvs_enable=0; esp_wifi_init(&wc); esp_wifi_set_storage(WIFI_STORAGE_RAM);
  esp_event_handler_register(WIFI_EVENT,ESP_EVENT_ANY_ID,on_evt,NULL); esp_event_handler_register(IP_EVENT,IP_EVENT_STA_GOT_IP,on_evt,NULL);
  wifi_config_t cfg={0}; strcpy((char*)cfg.sta.ssid,WSSID); strcpy((char*)cfg.sta.password,WPASS);
  esp_wifi_set_mode(WIFI_MODE_STA); esp_wifi_set_config(WIFI_IF_STA,&cfg); esp_wifi_start();
  while(!(xEventGroupWaitBits(eg,1,0,1,pdMS_TO_TICKS(10000))&1)){}
  snprintf(msg,sizeof msg,"slot phys=0x%x",(unsigned)phys); post("hello",msg);
  int in_ota1=(phys>=0x110000&&phys<0x210000), in_ota0=(phys>=0x10000&&phys<0x110000);
  if(!in_ota1&&!in_ota0){ snprintf(msg,sizeof msg,"UNKNOWN_SLOT phys=0x%x - doing nothing",(unsigned)phys); halt(msg); }
  if(!head) halt("NO_RAM for the 64 KB head buffer - doing nothing");
  APP_DST = in_ota1 ? 0x10000 : 0x1d0000;   /* ota_0 case: ESPHome app1 (we must not overwrite ourselves) */
  post("step","backing up full 4MB flash to receiver (16 x 256KB)...");
  for(uint32_t off=0;off<0x400000;off+=0x40000){ int tries=0; while(post_flash(off,0x40000)&&++tries<4) vTaskDelay(pdMS_TO_TICKS(1000));
    if(tries>=4){snprintf(msg,sizeof msg,"BACKUP_FAIL at 0x%x - not proceeding",(unsigned)off); halt(msg);} vTaskDelay(1); }
  post("step","BACKUP_DONE 4MB dumped");
  char m5[33]; int len=md5_http(m5);
  if(len!=EXP_LEN||strcmp(m5,EXP_MD5)){ snprintf(msg,sizeof msg,"DOWNLOAD_BAD len=%d md5=%s",len,m5); halt(msg); }
  snprintf(msg,sizeof msg,"READY slot=0x%x -> app will go to 0x%x (%s); download len=%d md5=%s OK; polling /go",(unsigned)phys,(unsigned)APP_DST,APP_DST==0x10000?"app0":"app1",len,m5); post("ready",msg);
  int polls=0; while(!go_ready()){ vTaskDelay(pdMS_TO_TICKS(5000)); if(++polls%12==0) post("waiting","still waiting for /go"); }
  post("GO","received GO - fetching factory.bin 0x0..0x10000 into RAM before writing anything");
  if(fetch_head()) halt(msg);
  snprintf(msg,sizeof msg,"head md5 OK; writing app (file 0x10000..0x%x) to flash 0x%x",EXP_LEN,(unsigned)APP_DST); post("step",msg);
  if(write_range(0x10000,EXP_LEN,APP_DST)) halt(msg);
  /* from here on: RAM copy only, no network until the final status posts */
  post("step","app written+verified; writing partition table 0x8000..0x9000 from RAM");
  if(write_head(0x8000,0x9000)) halt(msg);
  if(APP_DST==0x10000){ post("step","ptable ok; writing 0x9000..0x10000 (otadata/phy = FF -> boots app0)"); if(write_head(0x9000,0x10000)) halt(msg); }
  else { post("step","ptable ok; crafting otadata -> app1, FF for 0xb000..0x10000"); if(write_otadata_app1()) halt(msg); if(write_head(0xb000,0x10000)) halt(msg); }
  post("step","writing bootloader 0x0..0x8000 from RAM (LAST, <1s)");
  if(write_head(0x0,0x8000)) halt(msg);
  md5_flash(m5);
  if(strcmp(m5,EXP_MD5)){ snprintf(msg,sizeof msg,"VERIFY_FAIL flash md5=%s",m5); halt(msg); }
  snprintf(msg,sizeof msg,"VERIFIED flash 0x0..0x%x md5=%s == factory.bin; REBOOTING into ESPHome",EXP_LEN,m5); post("done",msg);
  vTaskDelay(pdMS_TO_TICKS(1500)); esp_restart();
}
